## meta-qoriq-sdk/conf/layer.conf
```bitbake
# We have a conf and classes directory, add to BBPATH
BBPATH .= ":${LAYERDIR}"

BSP_NXP_DERIVED ??= ""
# We have a packages directory, add to BBFILES
BBFILES += "${@bb.utils.contains_any('MACHINE', '${BSP_NXP_DERIVED}', '${LAYERDIR}/recipes-*/*/*.bb', '', d)}"
BBFILES += "${@bb.utils.contains_any('MACHINE', '${BSP_NXP_DERIVED}', '${LAYERDIR}/recipes-*/*/*.bbappend', '', d)}"

BBFILE_COLLECTIONS += "qoriq-sdk-release"
BBFILE_PATTERN_qoriq-sdk-release := "^${LAYERDIR}/"
BBFILE_PRIORITY_qoriq-sdk-release = "8"
LAYERSERIES_COMPAT_qoriq-sdk-release = "walnascar"
LAYERSERIES_COMPAT_qoriq-sdk-release = "styhead walnascar"

LAYERSERIES_COMPAT_security = "styhead walnascar"

LAYERDEPENDS_qoriq-sdk-release = "core freescale-layer yocto meta-arm"

HOSTTOOLS_NONFATAL:append = " whoami sha384sum xxd realpath"

BBFILES_DYNAMIC += " \
    virtualization-layer:${LAYERDIR}/dynamic-layers/virtualization-layer/*/*/*.bb \
    virtualization-layer:${LAYERDIR}/dynamic-layers/virtualization-layer/*/*/*.bbappend \
"

RECIPE_LIST_REASON:qoriq-sdk-release = "You are about to enable third-party components, there is additional third-part licensing involved, and you might need to consult with your legal department."

BBMASK += "${LAYERDIR}/dynamic-layers"
BBMASK += "${LAYERDIR}/recipes-extended"
BBMASK += "${LAYERDIR}/recipes-fsl"
```
